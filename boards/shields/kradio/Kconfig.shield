## boards/shields/kradio/Kconfig.shield
```kconfig
config SHIELD_KRADIO_CENTRAL
    def_bool $(shields_list_contains,kradio_central)

config SHIELD_KRADIO_LEFT
    def_bool $(shields_list_contains,kradio_left)

config SHIELD_KRADIO_RIGHT
    def_bool $(shields_list_contains,kradio_right)
```

## config/west.yml
```yaml
manifest:
  defaults:
    revision: v0.2
  remotes:
    - name: zmkfirmware
      url-base: https://github.com/zmkfirmware
    - name: badjeff
      url-base: https://github.com/badjeff
    - name: kbrd-space
      url-base: https://github.com/kbrd-space
    # Additional modules containing boards/shields/custom code can be listed here as well
    # See https://docs.zephyrproject.org/3.2.0/develop/west/manifest.html#projects
  projects:
    - name: zmk
      remote: zmkfirmware
      import: app/west.yml
    - name: zmk-pmw3610-driver
      remote: badjeff
      revision: main
    - name: zmk-anti-idle
      remote: kbrd-space
      revision: main
  self:
    path: config
```
